## package/libs/libmicroxml/Config.in
```kconfig
config PACKAGE_libmicroxml
	bool "libmicroxml"
	help
	  Tiny XML parsing library required by easycwmp.
	  This package provides the microxml library and pkg-config file.
```
